## CMakeLists.txt
```
# SPDX-License-Identifier: Apache-2.0

cmake_minimum_required(VERSION 3.20.0)

find_package(Zephyr REQUIRED HINTS $ENV{ZEPHYR_BASE})
project(peripheral_hr)

FILE(GLOB app_sources src/*.c)
target_sources(app PRIVATE
  ${app_sources}
  )

zephyr_library_include_directories(${ZEPHYR_BASE}/samples/bluetooth)
```

## Kconfig.sysbuild
```
# Copyright 2023-2024 Nordic Semiconductor ASA
# SPDX-License-Identifier: Apache-2.0

source "share/sysbuild/Kconfig"

config NET_CORE_BOARD
	string
	default "nrf5340dk/nrf5340/cpunet" if $(BOARD) = "nrf5340dk"
	default "nrf5340_audio_dk/nrf5340/cpunet" if $(BOARD) = "nrf5340_audio_dk"
	default "nrf5340bsim/nrf5340/cpunet" if $(BOARD_TARGET_STRING) = "NRF5340BSIM_NRF5340_CPUAPP"

config NET_CORE_IMAGE_HCI_IPC
	bool "HCI IPC image on network core"
	default y
	depends on NET_CORE_BOARD != ""
```

## sample.yaml
```
sample:
  name: Bluetooth Peripheral HR
  description: Demonstrates the HR (Heart Rate) GATT Service
tests:
  sample.bluetooth.peripheral_hr:
    harness: bluetooth
    platform_allow:
      - qemu_cortex_m3
      - qemu_x86
      - nrf52_bsim
      - nrf5340bsim/nrf5340/cpuapp
      - nrf51dk/nrf51822
      - nrf52dk/nrf52832
      - nrf52840dk/nrf52840
      - nrf5340dk/nrf5340/cpuapp
      - nrf54l15dk/nrf54l15/cpuapp
    integration_platforms:
      - qemu_cortex_m3
      - nrf52_bsim
      - nrf5340bsim/nrf5340/cpuapp
      - nrf51dk/nrf51822
      - nrf52dk/nrf52832
      - nrf52840dk/nrf52840
      - nrf5340dk/nrf5340/cpuapp
      - nrf54l15dk/nrf54l15/cpuapp
    tags: bluetooth
  sample.bluetooth.peripheral_hr.minimal:
    harness: bluetooth
    platform_allow:
      - bbc_microbit
    integration_platforms:
      - bbc_microbit
    extra_args: EXTRA_CONF_FILE=prj_minimal.conf
    tags: bluetooth
  sample.bluetooth.peripheral_hr.bt_ll_sw_split.extended:
    harness: bluetooth
    platform_allow:
      - nrf52_bsim
      - nrf5340bsim/nrf5340/cpuapp
      - nrf52dk/nrf52832
      - nrf52840dk/nrf52840
      - nrf5340dk/nrf5340/cpuapp
    integration_platforms:
      - nrf52_bsim
      - nrf5340bsim/nrf5340/cpuapp
      - nrf52dk/nrf52832
      - nrf52840dk/nrf52840
      - nrf5340dk/nrf5340/cpuapp
    extra_args: EXTRA_CONF_FILE=overlay-extended.conf
    tags: bluetooth
  sample.bluetooth.peripheral_hr.bt_ll_sw_split.phy_coded:
    harness: bluetooth
    platform_allow:
      - nrf52_bsim
      - nrf5340bsim/nrf5340/cpuapp
      - nrf52dk/nrf52832
      - nrf52840dk/nrf52840
      - nrf5340dk/nrf5340/cpuapp
    integration_platforms:
      - nrf52_bsim
      - nrf5340bsim/nrf5340/cpuapp
      - nrf52dk/nrf52832
      - nrf52840dk/nrf52840
      - nrf5340dk/nrf5340/cpuapp
    extra_args: EXTRA_CONF_FILE=overlay-phy_coded.conf
    tags: bluetooth
  sample.bluetooth.peripheral_hr_rv32m1_vega_openisa_rv32m1_ri5cy:
    platform_allow: rv32m1_vega/openisa_rv32m1/ri5cy
    tags: bluetooth
    build_only: true
  sample.bluetooth.peripheral_hr.frdm_kw41z_shield:
    harness: bluetooth
    depends_on: arduino_serial
    tags: bluetooth
    extra_args: SHIELD=frdm_kw41z
```

## prj.conf
```kconfig
CONFIG_BT=y
CONFIG_LOG=y
CONFIG_BT_SMP=y
CONFIG_BT_PERIPHERAL=y
CONFIG_BT_DIS=y
CONFIG_BT_DIS_PNP=n
CONFIG_BT_BAS=y
CONFIG_BT_HRS=y
CONFIG_BT_DEVICE_NAME="MChedas GFaye"
CONFIG_BT_GATT_CLIENT=y
CONFIG_BT_GATT_DYNAMIC_DB=y
CONFIG_BT_DEVICE_APPEARANCE=0
CONFIG_BT_MAX_CONN=1
```

## overlay-extended.conf
```kconfig
CONFIG_BT_EXT_ADV=y

# Increase Advertising Data Length, as Complete Local Name too needs to be
# placed in the AUX_ADV_IND PDU compared to when it is placed in ADV_SCAN_IND
# PDU in the case of legacy advertising.
CONFIG_BT_CTLR_ADV_DATA_LEN_MAX=36
```

## overlay-phy_coded.conf
```kconfig
CONFIG_BT_EXT_ADV=y

# Enable Coded PHY support
CONFIG_BT_CTLR_PHY_CODED=y

# Disable auto PHY update, to switch to 2M PHY
CONFIG_BT_AUTO_PHY_UPDATE=n

# Increase Advertising Data Length, as Complete Local Name too needs to be
# placed in the AUX_ADV_IND PDU compared to when it is placed in ADV_SCAN_IND
# PDU in the case of legacy advertising.
CONFIG_BT_CTLR_ADV_DATA_LEN_MAX=36
```

## prj_minimal.conf
```kconfig
CONFIG_BT=y
CONFIG_BT_SMP=y
CONFIG_BT_PERIPHERAL=y
CONFIG_BT_DIS=y
CONFIG_BT_DIS_PNP=n
CONFIG_BT_BAS=y
CONFIG_BT_HRS=y
CONFIG_BT_DEVICE_NAME="Zephyr Heartrate Sensor"
CONFIG_BT_DEVICE_APPEARANCE=833

# Drivers and peripherals
CONFIG_I2C=n
CONFIG_WATCHDOG=n
CONFIG_PINCTRL=n
CONFIG_SPI=n
CONFIG_GPIO=n
CONFIG_SERIAL=n

# Power management
CONFIG_PM=n

# Interrupts
CONFIG_DYNAMIC_INTERRUPTS=n
CONFIG_IRQ_OFFLOAD=n

# Memory protection
CONFIG_THREAD_STACK_INFO=n
CONFIG_THREAD_CUSTOM_DATA=n
CONFIG_FPU=n

# Boot
CONFIG_BOOT_BANNER=n
CONFIG_BOOT_DELAY=0

# Console
CONFIG_CONSOLE=n
CONFIG_UART_CONSOLE=n
CONFIG_STDOUT_CONSOLE=n
CONFIG_PRINTK=n
CONFIG_EARLY_CONSOLE=n

# Build
CONFIG_SIZE_OPTIMIZATIONS=y

# ARM
CONFIG_ARM_MPU=n

# In order to correctly tune the stack sizes for the threads the following
# Configurations can enabled to print the current use:
# CONFIG_THREAD_NAME=y
# CONFIG_THREAD_ANALYZER=y
# CONFIG_THREAD_ANALYZER_AUTO=y
# CONFIG_THREAD_ANALYZER_RUN_UNLOCKED=y
# CONFIG_THREAD_ANALYZER_USE_PRINTK=y
# CONFIG_THREAD_ANALYZER_AUTO_INTERVAL=20
# CONFIG_CONSOLE=y
# CONFIG_UART_CONSOLE=y
# CONFIG_SERIAL=y
# CONFIG_PRINTK=y

# Example output of thread analyzer
# BT RX               : STACK: unused 576 usage 448 / 1024 (43 %); CPU: 0 %
# BT RX pri           : STACK: unused 260 usage 188 / 448 (41 %); CPU: 0 %
# BT ECC              : STACK: unused 256 usage 888 / 1144 (77 %); CPU: 1 %
# BT TX               : STACK: unused 296 usage 344 / 640 (53 %); CPU: 0 %
# thread_analyzer     : STACK: unused 128 usage 384 / 512 (75 %); CPU: 1 %
# sysworkq            : STACK: unused 856 usage 168 / 1024 (16 %); CPU: 0 %
# logging             : STACK: unused 232 usage 536 / 768 (69 %); CPU: 0 %
# idle 00             : STACK: unused 208 usage 48 / 256 (18 %); CPU: 97 %
# main                : STACK: unused 576 usage 448 / 1024 (43 %); CPU: 0 %
CONFIG_BT_RX_STACK_SIZE=1024
CONFIG_BT_HCI_TX_STACK_SIZE_WITH_PROMPT=y
CONFIG_BT_HCI_TX_STACK_SIZE=640
CONFIG_SYSTEM_WORKQUEUE_STACK_SIZE=512
CONFIG_IDLE_STACK_SIZE=128
CONFIG_MAIN_STACK_SIZE=640
CONFIG_ISR_STACK_SIZE=1024

# Disable features not needed
CONFIG_TIMESLICING=n
CONFIG_COMMON_LIBC_MALLOC=n
CONFIG_LOG=n
CONFIG_ASSERT=n

# Disable Bluetooth features not needed
# CONFIG_BT_DEBUG_NONE=y
CONFIG_BT_ASSERT=n
CONFIG_BT_DATA_LEN_UPDATE=n
CONFIG_BT_PHY_UPDATE=n
CONFIG_BT_GATT_CACHING=n
CONFIG_BT_GATT_SERVICE_CHANGED=n
CONFIG_BT_GAP_PERIPHERAL_PREF_PARAMS=n
CONFIG_BT_SETTINGS_CCC_LAZY_LOADING=y
CONFIG_BT_HCI_VS=n

# Disable Bluetooth controller features not needed
CONFIG_BT_CTLR_PRIVACY=n
CONFIG_BT_CTLR_PHY_2M=n

# Reduce Bluetooth buffers
CONFIG_BT_BUF_EVT_DISCARDABLE_COUNT=1
CONFIG_BT_BUF_EVT_DISCARDABLE_SIZE=45
CONFIG_BT_BUF_ACL_RX_COUNT=2
CONFIG_BT_BUF_EVT_RX_COUNT=2

CONFIG_BT_L2CAP_TX_BUF_COUNT=2
CONFIG_BT_CTLR_RX_BUFFERS=1
CONFIG_BT_BUF_ACL_TX_COUNT=3
CONFIG_BT_BUF_ACL_TX_SIZE=27
```

## boards/nrf5340bsim_nrf5340_cpuapp.conf
```kconfig
# Set same the ACL RX buffer size as in hci_ipc on netcore so that
# HCI Controller to Host Flowcontrol is supported.
CONFIG_BT_BUF_ACL_RX_SIZE=255
```

## src/main.c
```c
/* main.c - Application main entry point */

/*
 * Copyright (c) 2024 Nordic Semiconductor ASA
 * Copyright (c) 2015-2016 Intel Corporation
 *
 * SPDX-License-Identifier: Apache-2.0
 */

#include <zephyr/device.h>
#include <zephyr/devicetree.h>
#include <zephyr/drivers/gpio.h>
#include <zephyr/kernel.h>

#include <zephyr/bluetooth/bluetooth.h>
#include <zephyr/bluetooth/hci.h>
#include <zephyr/bluetooth/conn.h>
#include <zephyr/bluetooth/uuid.h>
#include <zephyr/bluetooth/gatt.h>
#include <zephyr/bluetooth/services/bas.h>
#include <zephyr/bluetooth/services/hrs.h>

/* The devicetree node identifiers for the LEDs and button */
#define LED_BUTTON_NODE DT_ALIAS(led0)
#define LED_BLINK_NODE DT_ALIAS(led1)
#define LED_REMOTE_NODE DT_ALIAS(led2)

#define BUTTON_NODE DT_ALIAS(sw0)

static const struct gpio_dt_spec led_button = GPIO_DT_SPEC_GET(LED_BUTTON_NODE, gpios);
static const struct gpio_dt_spec led_blink = GPIO_DT_SPEC_GET(LED_BLINK_NODE, gpios);
static const struct gpio_dt_spec button = GPIO_DT_SPEC_GET(BUTTON_NODE, gpios);

static const struct gpio_dt_spec led_remote = GPIO_DT_SPEC_GET(LED_REMOTE_NODE, gpios);


/* UUID du service et de la characteristic */
static struct bt_uuid_16 remote_led_service_uuid = BT_UUID_INIT_16(0x1600);
static struct bt_uuid_16 remote_led_char_uuid    = BT_UUID_INIT_16(0x1601);



static struct gpio_callback button_cb_data;

/* Variables for blinking */
static struct k_work_delayable blink_work;
static bool led_blink_is_on = false;


/* CallBack Receiver*/
static ssize_t write_remote_led(struct bt_conn *conn,
				const struct bt_gatt_attr *attr,
				const void *buf, uint16_t len,
				uint16_t offset, uint8_t flags)
{
    if (len < 1) {
        return BT_GATT_ERR(BT_ATT_ERR_INVALID_ATTRIBUTE_LEN);
    }

    uint8_t value = ((uint8_t *)buf)[0];  // 0x00 ou 0x01

    gpio_pin_set(led_remote.port, led_remote.pin, value ? 1 : 0);

    printk("LED2 commandée via BLE : %d\n", value);

    return len;
}

BT_GATT_SERVICE_DEFINE(remote_led_svc,
	BT_GATT_PRIMARY_SERVICE(&remote_led_service_uuid),
	BT_GATT_CHARACTERISTIC(&remote_led_char_uuid.uuid,
			       BT_GATT_CHRC_WRITE,
			       BT_GATT_PERM_WRITE,
			       NULL, write_remote_led, NULL),
);



/* Callback function for button press */
static void button_pressed(const struct device *dev, struct gpio_callback *cb, uint32_t pins)
{
    /* Toggle the button-controlled LED */
    gpio_pin_toggle(led_button.port, led_button.pin);
    printk("Bouton pressé : LED contrôlée par le bouton changée d'état\n");
}

/* Function for blinking LED */
static void blink_timeout(struct k_work *work)
{
    led_blink_is_on = !led_blink_is_on;
    gpio_pin_set(led_blink.port, led_blink.pin, (int)led_blink_is_on);

    k_work_schedule(&blink_work, K_MSEC(500)); /* Clignote toutes les 500 ms */
}



static bool hrf_ntf_enabled;

static const struct bt_data ad[] = {
	BT_DATA_BYTES(BT_DATA_FLAGS, (BT_LE_AD_GENERAL | BT_LE_AD_NO_BREDR)),
	BT_DATA_BYTES(BT_DATA_UUID16_ALL,
		      BT_UUID_16_ENCODE(BT_UUID_HRS_VAL),
		      BT_UUID_16_ENCODE(BT_UUID_BAS_VAL),
		      BT_UUID_16_ENCODE(BT_UUID_DIS_VAL)),
#if defined(CONFIG_BT_EXT_ADV)
	BT_DATA(BT_DATA_NAME_COMPLETE, CONFIG_BT_DEVICE_NAME, sizeof(CONFIG_BT_DEVICE_NAME) - 1),
#endif /* CONFIG_BT_EXT_ADV */
};

#if !defined(CONFIG_BT_EXT_ADV)
static const struct bt_data sd[] = {
	BT_DATA(BT_DATA_NAME_COMPLETE, CONFIG_BT_DEVICE_NAME, sizeof(CONFIG_BT_DEVICE_NAME) - 1),
};
#endif /* !CONFIG_BT_EXT_ADV */

/* Use atomic variable, 2 bits for connection and disconnection state */
static ATOMIC_DEFINE(state, 2U);

#define STATE_CONNECTED    1U
#define STATE_DISCONNECTED 2U

static void connected(struct bt_conn *conn, uint8_t err)
{
	if (err) {
		printk("Connection failed, err 0x%02x %s\n", err, bt_hci_err_to_str(err));
	} else {
		printk("Connected\n");

		(void)atomic_set_bit(state, STATE_CONNECTED);
	}
}

static void disconnected(struct bt_conn *conn, uint8_t reason)
{
	printk("Disconnected, reason 0x%02x %s\n", reason, bt_hci_err_to_str(reason));

	(void)atomic_set_bit(state, STATE_DISCONNECTED);
}

BT_CONN_CB_DEFINE(conn_callbacks) = {
	.connected = connected,
	.disconnected = disconnected,
};

static void hrs_ntf_changed(bool enabled)
{
	hrf_ntf_enabled = enabled;

	printk("HRS notification status changed: %s\n",
	       enabled ? "enabled" : "disabled");
}

static struct bt_hrs_cb hrs_cb = {
	.ntf_changed = hrs_ntf_changed,
};

static void auth_cancel(struct bt_conn *conn)
{
	char addr[BT_ADDR_LE_STR_LEN];

	bt_addr_le_to_str(bt_conn_get_dst(conn), addr, sizeof(addr));

	printk("Pairing cancelled: %s\n", addr);
}

static struct bt_conn_auth_cb auth_cb_display = {
	.cancel = auth_cancel,
};

static void bas_notify(void)
{
	uint8_t battery_level = bt_bas_get_battery_level();

	battery_level--;

	if (!battery_level) {
		battery_level = 100U;
	}

	bt_bas_set_battery_level(battery_level);
}

static void hrs_notify(void)
{
	static uint8_t heartrate = 90U;

	/* Heartrate measurements simulation */
	heartrate++;
	if (heartrate == 160U) {
		heartrate = 90U;
	}

	if (hrf_ntf_enabled) {
		bt_hrs_notify(heartrate);
	}
}

void main(void)
{
    int ret;

    printk("Initialisation des GPIOs...\n");

    /* Configure the button-controlled LED */
    if (!gpio_is_ready_dt(&led_button)) {
        printk("Erreur : le périphérique LED_BUTTON n'est pas prêt\n");
        return;
    }
    ret = gpio_pin_configure_dt(&led_button, GPIO_OUTPUT_INACTIVE);
    if (ret < 0) {
        printk("Erreur lors de la configuration de LED_BUTTON (code %d)\n", ret);
        return;
    }

    /* Configure the blinking LED */
    if (!gpio_is_ready_dt(&led_blink)) {
        printk("Erreur : le périphérique LED_BLINK n'est pas prêt\n");
        return;
    }
    ret = gpio_pin_configure_dt(&led_blink, GPIO_OUTPUT_INACTIVE);
    if (ret < 0) {
        printk("Erreur lors de la configuration de LED_BLINK (code %d)\n", ret);
        return;
    }

    /* Configure the Button GPIO */
    if (!gpio_is_ready_dt(&button)) {
        printk("Erreur : le périphérique BUTTON n'est pas prêt\n");
        return;
    }
    ret = gpio_pin_configure_dt(&button, GPIO_INPUT);
    if (ret < 0) {
        printk("Erreur lors de la configuration du bouton (code %d)\n", ret);
        return;
    }

    ret = gpio_pin_interrupt_configure_dt(&button, GPIO_INT_EDGE_TO_ACTIVE);
    if (ret < 0) {
        printk("Erreur lors de la configuration de l'interruption du bouton (code %d)\n", ret);
        return;
    }

	if (!gpio_is_ready_dt(&led_remote)) {
		printk("LED2 non prête\n");
		return;
	}

	int ret_led_remote = gpio_pin_configure_dt(&led_remote, GPIO_OUTPUT_INACTIVE);
	if (ret_led_remote < 0) {
		printk("Erreur configuration LED2 (%d)\n", ret_led_remote);
		return;
	}



    gpio_init_callback(&button_cb_data, button_pressed, BIT(button.pin));
    gpio_add_callback(button.port, &button_cb_data);

    printk("Configuration terminée. Appuyez sur le bouton pour contrôler LED_BUTTON. LED_BLINK clignote automatiquement.\n");

    /* Start blinking LED */
    k_work_init_delayable(&blink_work, blink_timeout);
    k_work_schedule(&blink_work, K_MSEC(500)); /* Démarre le clignotement */

    int err;

	err = bt_enable(NULL);
	if (err) {
		printk("Bluetooth init failed (err %d)\n", err);
		return;
	}

	printk("Bluetooth initialized\n");

	bt_conn_auth_cb_register(&auth_cb_display);

	bt_hrs_cb_register(&hrs_cb);

#if !defined(CONFIG_BT_EXT_ADV)
	printk("Starting Legacy Advertising (connectable and scannable)\n");
	err = bt_le_adv_start(BT_LE_ADV_CONN_ONE_TIME, ad, ARRAY_SIZE(ad), sd, ARRAY_SIZE(sd));
	if (err) {
		printk("Advertising failed to start (err %d)\n", err);
		return;
	}

#else /* CONFIG_BT_EXT_ADV */
	struct bt_le_adv_param adv_param = {
		.id = BT_ID_DEFAULT,
		.sid = 0U,
		.secondary_max_skip = 0U,
		.options = (BT_LE_ADV_OPT_EXT_ADV |
			    BT_LE_ADV_OPT_CONNECTABLE |
			    BT_LE_ADV_OPT_CODED),
		.interval_min = BT_GAP_ADV_FAST_INT_MIN_2,
		.interval_max = BT_GAP_ADV_FAST_INT_MAX_2,
		.peer = NULL,
	};
	struct bt_le_ext_adv *adv;

	printk("Creating a Coded PHY connectable non-scannable advertising set\n");
	err = bt_le_ext_adv_create(&adv_param, NULL, &adv);
	if (err) {
		printk("Failed to create Coded PHY extended advertising set (err %d)\n", err);

		printk("Creating a non-Coded PHY connectable non-scannable advertising set\n");
		adv_param.options &= ~BT_LE_ADV_OPT_CODED;
		err = bt_le_ext_adv_create(&adv_param, NULL, &adv);
		if (err) {
			printk("Failed to create extended advertising set (err %d)\n", err);
			return;
		}
	}

	printk("Setting extended advertising data\n");
	err = bt_le_ext_adv_set_data(adv, ad, ARRAY_SIZE(ad), NULL, 0);
	if (err) {
		printk("Failed to set extended advertising data (err %d)\n", err);
		return;
	}

	printk("Starting Extended Advertising (connectable non-scannable)\n");
	err = bt_le_ext_adv_start(adv, BT_LE_EXT_ADV_START_DEFAULT);
	if (err) {
		printk("Failed to start extended advertising set (err %d)\n", err);
		return;
	}
#endif /* CONFIG_BT_EXT_ADV */

	printk("Advertising successfully started\n");

	/* Implement notification. */
	while (1) {
		k_sleep(K_SECONDS(1));

		/* Heartrate measurements simulation */
		hrs_notify();

		/* Battery level simulation */
		bas_notify();

		if (atomic_test_and_clear_bit(state, STATE_CONNECTED)) {
			/* Connected callback executed */
		} else if (atomic_test_and_clear_bit(state, STATE_DISCONNECTED)) {
#if !defined(CONFIG_BT_EXT_ADV)
			printk("Starting Legacy Advertising (connectable and scannable)\n");
			err = bt_le_adv_start(BT_LE_ADV_CONN_ONE_TIME, ad, ARRAY_SIZE(ad), sd,
					      ARRAY_SIZE(sd));
			if (err) {
				printk("Advertising failed to start (err %d)\n", err);
				return;
			}

#else /* CONFIG_BT_EXT_ADV */
			printk("Starting Extended Advertising (connectable and non-scannable)\n");
			err = bt_le_ext_adv_start(adv, BT_LE_EXT_ADV_START_DEFAULT);
			if (err) {
				printk("Failed to start extended advertising set (err %d)\n", err);
				return;
			}
#endif /* CONFIG_BT_EXT_ADV */
		}
	}
}
```
